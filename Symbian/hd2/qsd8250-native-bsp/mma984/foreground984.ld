ENTRY(ForegroundOwner984)
ForegroundNewL = 0x19319;
CleanupPushL = 0x8a04;
GlobalVolumeNewL = 0x19473;
CleanupPop = 0x8c64;
SetGlobalVolume = 0xcc91;
SECTIONS { . = 0x19804; .text : { *(.text) } /DISCARD/ : { *(.ARM.attributes) *(.comment) } }
